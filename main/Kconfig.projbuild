## main/Kconfig.projbuild
```kconfig
menu "Whoop Gate Configuration"
    menu "General"
        config WHOOP_PIN
            int "PIN"
            default 26
        config WHOOP_N_LED
            int "NUMBER OF LEDS"
            default 150
    endmenu

    menu "Wifi connect"
        config WIFI_SSID
            string "SSID"
            default "ssid"
        config WIFI_PASSWORD
            string "PASSWORD"
            default "password"
    endmenu

    menu "MQTT client"
        config MQTT_URI
            string "URI"
            default "uri"
        config MQTT_USER
            string "USERNAME"
            default "my_user"
        config MQTT_PASSWORD
            string "PASSWORD"
            default "my_password"
    endmenu

    menu "OTA"
        config OTA_URL
            string "URL"
            default "url"
    endmenu
endmenu
```

## sdkconfig.defaults
```kconfig
CONFIG_OTA_URL="https://drive.google.com/uc?authuser=0&id=11XYVdkM3UITT6DvoiekVCdWaMuPSFtMz&export=download"
CONFIG_WHOOP_ID="gate1"
CONFIG_PARTITION_TABLE_TWO_OTA=
CONFIG_PARTITION_TABLE_CUSTOM_FILENAME="partitions.csv"
CONFIG_PARTITION_TABLE_FILENAME="partitions_two_ota.csv"
CONFIG_PARTITION_TABLE_OFFSET=0x8000
CONFIG_PARTITION_TABLE_MD5=y
CONFIG_ESPTOOLPY_FLASHSIZE="4MB"
```
